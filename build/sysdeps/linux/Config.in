## build/sysdeps/linux/Config.in
```kconfig
#
# For a description of the syntax of this configuration file,
# see scripts/kbuild/config-language.txt.
#

mainmenu "Lettuce Configuration"

config HAVE_DOT_CONFIG
	bool
	default y

menu "General Configuration"

choice
	prompt "CPU Type"
	default INCLUDE_CPU
	help
	  Choose CPU type

config INCLUDE_CPU_TC3162U
	bool "Ralink TC3162U"

config INCLUDE_CPU_TC3182
	bool "Ralink TC3182"

config INCLUDE_CPU_RTL8672
	bool "Realtek RTL8672"

config INCLUDE_CPU_VR268
	bool "Lantiq VR268"

config INCLUDE_CPU_VR288
	bool "Lantiq VR288"
	
config INCLUDE_CPU_AR9344
	bool "Atheros AR9344"

config INCLUDE_CPU_AR9558
	bool "Atheros AR9558"

config INCLUDE_CPU_RT63368
	bool "MTK RT63368"
	
config INCLUDE_CPU_RT63365
	bool "MTK RT63365"

config INCLUDE_CPU_88F6550 
	bool "Marvell 88F6550" 
	
config INCLUDE_CPU_MT7513
	bool "MTK MT7513"
	
config INCLUDE_CPU_BCM96318
	bool "Broadcom BCM96318"
	
config INCLUDE_CPU_BCM63168
	bool "Broadcom BCM63168"

config INCLUDE_CPU_BCM63167
	bool "Broadcom BCM63167"

config INCLUDE_CPU_BCM6361
	bool "Broadcom BCM6361"

config INCLUDE_CPU_BCM63381
	bool "Broadcom BCM63381"

endchoice
	

config INCLUDE_LINUX_VERSION_3
	depends on INCLUDE_CPU_BCM6318 || INCLUDE_CPU_BCM63168 || INCLUDE_CPU_BCM6361 || INCLUDE_CPU_BCM63381 || INCLUDE_CPU_BCM63167
	def_bool y 
	
config KERNEL_MAX_SIZE 
    hex "Kernel bin max size" 
    default "0x110000" 

choice
    prompt "TARGET_CPU_ENDIAN"
    default INCLUDE_CPU_BIG_ENDIAN

config INCLUDE_CPU_BIG_ENDIAN
    bool "TARGET CPU BIG ENDIAN"

config INCLUDE_CPU_LITTLE_ENDIAN
    bool "TARGET CPU LITTLE ENDIAN"

endchoice


choice 
    prompt "MTD part type" 
    default INCLUDE_MTD_TYPE1 
    help     
      Choose MTD type 
 
config INCLUDE_MTD_TYPE1 
    bool "Default 6 MTD parts" 
 
config INCLUDE_MTD_TYPE2 
    bool "Lantiq 7 MTD parts(8MB)" 

config INCLUDE_MTD_TYPE3 
    bool "Lantiq 7 MTD parts(16MB) or Broadcom 4 MTD parts(64M NAND)" 
 
config INCLUDE_MTD_TYPE4 
    bool "Broadcom 6 MTD parts(8MB,64kB boot)" 
 
config INCLUDE_MTD_TYPE5 
    bool "Broadcom 6 MTD parts(64MB SPI,256kB boot)" 
 
endchoice

choice
	prompt "flash size" 
    default INCLUDE_FLASH_16M 
    help     
      Choose flash size
	  
config INCLUDE_FLASH_8M
	bool "8MB Flash Size"

config INCLUDE_FLASH_16M
	bool "16MB Flash Size"

config INCLUDE_FLASH_128M
	bool "128M flash size"
	
endchoice

config CONFIG_ECC_BITS 
	depends on INCLUDE_MTD_TYPE3 && (INCLUDE_CPU_BCM63168 || INCLUDE_CPU_BCM6361 || INCLUDE_CPU_BCM63381 || INCLUDE_CPU_BCM63167)
	int "ECC selection,only 1-bit Hamming,4-bit or 8-bit BCH supported now"
	range 0,8
	default 1

choice
	prompt "Product language"
	default INCLUDE_LANGUAGE
	help
	  Choose language type

config INCLUDE_LANGUAGE_CN
	bool "Chinese language"

config INCLUDE_LANGUAGE_EN
	bool "English language"

endchoice

choice
	prompt "ETH Type"
	default INCLUDE_ETH_UNKNOW

config INCLUDE_ETH_LTQ
	bool "Build Lantiq ethernet"
	default n
	
config INCLUDE_ETH_RA
	bool "Build Ralink ethernet"
	default n

config INCLUDE_ETH_BCM
	bool "Build Broadcom ethernet"

config INCLUDE_ETH_ATH
	bool "Build Atheros ethernet"
	default n

config INCLUDE_GMAC1_ONLY
	bool "Build gmac1 only"
	depends on INCLUDE_ETH_ATH
	default n
endchoice

config INCLUDE_DIGITAL_SIGNATURE
	bool "Digital signature"
	default n
	
config INCLUDE_WATCHDOG
	bool "Enable watchdog"
	default n
	
config INCLUDE_CUSTOMIZED_SP
	string "Customize for specified SP" 
	default "" 
	help
		If not empty,you can create default_config_SP.xml & reduced_data_model_SP.xml at the config directory,
		also,you can crate a directory named as SP under the web directory and this directory has the same structure
		as the web directory,then you can copy the html files you want to modify to the relative directory and modify
		them as you want. O'course,you can skip creating the config files or the web directory,so this MACRO will be ignored


config INCLUDE_DUAL_IMAGE
	bool "Build Dual Image"
	default n
	
config INCLUDE_DUAL_CONFIG
	bool "Build Dual Config"
	default n
	
config INCLUDE_PPA_ACCELERATE
	bool "Enable Lantiq PPA accelerate"
	default n

config INCLUDE_CLI_FULL_FEATURE 
	bool "Include all cli cmd"
	default y
	
config INCLUDE_USER_ACCOUNT
	bool "Enable user account,default no need set"
	default n
	
config INCLUDE_CHGINIT_PWD
	bool "Enable change password when init"
	default n

config INCLUDE_AUTH_PASSWORD
	bool "Only auth password"
	depends on INCLUDE_CHGINIT_PWD
	default n

config INCLUDE_FACTORY_DEFAULT
	bool "Enable Factory Default flag"
	default n
	
config INCLUDE_ENCRYPT_PASSWORD
	bool "Enable password enryption"
	default n
	
config INCLUDE_MIC
	bool "Support MIC system"
	default n
	
config INCLUDE_NEW_VI
	bool "Support TP-LINK new VI"
	default n
	
config INCLUDE_TEST
	bool "test config by yangxv"
	default n

config INCLUDE_KERNEL_MONITOR
	bool "Enable kernel monitor in cos module"
	default n

endmenu

#source archival/Config.in

#
# Wireless options
#
menu 'Wireless Options'

config INCLUDE_LAN_WLAN
	bool "Build wireless"
	default n
	
config INCLUDE_LAN_WLAN_MSSID
	bool "Build wireless Multi-SSID"
	depends on INCLUDE_LAN_WLAN
	default n

config INCLUDE_LAN_WLAN_GUESTNETWORK
	bool "Build wireless GuestNetwork"
	depends on INCLUDE_LAN_WLAN_MSSID
	default n
	
config INCLUDE_LAN_WLAN_WDS
	bool "Build wireless WDS"
	depends on INCLUDE_LAN_WLAN
	default n
	
config INCLUDE_LAN_WLAN_WDS_DETECT
	bool "Build wireless wds address mode detect"
	depends on INCLUDE_LAN_WLAN_WDS
	default n

config INCLUDE_LAN_WLAN_BANDSTEERING
	bool "Build wireless BandSteering"
	depends on INCLUDE_LAN_WLAN
	default n

config INCLUDE_LAN_WLAN_8021X
	bool "Build wireless 802.1x"
	depends on INCLUDE_LAN_WLAN
	default y
	
config INCLUDE_RADIUS_ACCOUNTING
	bool "Build radius accounting"
	depends on INCLUDE_WLAN_RA && INCLUDE_LAN_WLAN_8021X
	default n

config INCLUDE_LAN_WLAN_DUALBAND
	bool "Build wlan dual band"
	depends on INCLUDE_LAN_WLAN
	default y	
		
config INCLUDE_LAN_WLAN_AC
	bool "Build wlan 802.11ac"
	depends on INCLUDE_LAN_WLAN
	default n
	
config INCLUDE_LAN_WLAN_SCHEDULE
	bool "Build wireless schedule"
	depends on INCLUDE_LAN_WLAN
	default n

config INCLUDE_LAN_WLAN_ASSOC_SAVE_NO_OBJECT
	bool "Build wlan clients save no object"
	depends on INCLUDE_LAN_WLAN
	default n
	
config WLAN_VAP_NUM
	depends on INCLUDE_LAN_WLAN
	int "VAP NUM"
	range 1 3
	default 1
	
choice
	prompt "WIFI Type"
	default INCLUDE_WLAN_UNKNOW
	depends on INCLUDE_LAN_WLAN

config INCLUDE_WLAN_RA
	bool "Build Ralink WIFI"
	depends on INCLUDE_LAN_WLAN
	default n
	
config INCLUDE_WLAN_RTL
	bool "Build Realtek WIFI"
	depends on INCLUDE_LAN_WLAN
	default n
	
config INCLUDE_WLAN_ATH
	bool "Build Atheros WIFI"
	depends on INCLUDE_LAN_WLAN
	default n

config INCLUDE_WLAN_BCM
	bool "Build Broadcom WIFI"
	depends on INCLUDE_LAN_WLAN
	default n
endchoice

menu "MTK WIFI 5G CHIP Type"
config INCLUDE_WIFI_5G_CHIP_MT7612E
	bool "Ralink MT7612E"
	depends on INCLUDE_WLAN_RA && INCLUDE_LAN_WLAN_DUALBAND
	default n

config INCLUDE_WIFI_5G_CHIP_MT7613E
	bool "Ralink MT7613E"
	depends on INCLUDE_WLAN_RA && INCLUDE_LAN_WLAN_DUALBAND
	default n

config INCLUDE_WIFI_5G_CHIP_MT7615E
	bool "Ralink MT7615E"
	depends on INCLUDE_WLAN_RA && INCLUDE_LAN_WLAN_DUALBAND
	default n
endmenu

choice 
	prompt "ATH G_BAND MIMO NUM "
	default ATH_G_BAND_MIMO_UNKOWN
	depends on INCLUDE_WLAN_ATH
	
config ATH_G_BAND_MIMO_NUM_2_2
	bool "ATH_G_BAND_MOMO_NUM_2x2"
	depends on INCLUDE_WLAN_ATH
	
config ATH_G_BAND_MIMO_NUM_3_3
	bool "ATH_G_BAND_MOMO_NUM_3x3"
	depends on INCLUDE_WLAN_ATH
	
endchoice

choice 
	prompt "ATH A BAND MIMO NUM "
	default ATH_A_BAND_MIMO_UNKOWN
	depends on INCLUDE_WLAN_ATH
	
config ATH_A_BAND_MIMO_NUM_3_3
	bool "ATH_A_BAND_MOMO_NUM_3x3"
	depends on INCLUDE_WLAN_ATH
	
endchoice
	
choice 
	prompt "BCM B_BAND MIMO NUM "
	default BCM_B_BAND_MIMO_UNKOWN
	depends on INCLUDE_WLAN_BCM
	
config BCM_B_BAND_MIMO_NUM_1_1
	bool "BCM_B_BAND_MOMO_NUM_1x1"
	depends on INCLUDE_WLAN_BCM
	
config BCM_B_BAND_MIMO_NUM_2_2
	bool "BCM_B_BAND_MOMO_NUM_2x2"
	depends on INCLUDE_WLAN_BCM
	
config BCM_B_BAND_MIMO_NUM_3_3
	bool "BCM_B_BAND_MOMO_NUM_3x3"
	depends on INCLUDE_WLAN_BCM
	
endchoice

choice 
	prompt "BCM A BAND MIMO NUM "
	default BCM_A_BAND_MIMO_UNKOWN
	depends on INCLUDE_WLAN_BCM && INCLUDE_LAN_WLAN_DUALBAND
	
config BCM_A_BAND_MIMO_NUM_1_1
	bool "BCM_A_BAND_MOMO_NUM_1x1"
	depends on INCLUDE_WLAN_BCM
	
config BCM_A_BAND_MIMO_NUM_2_2
	bool "BCM_A_BAND_MOMO_NUM_2x2"
	depends on INCLUDE_WLAN_BCM
	
config BCM_A_BAND_MIMO_NUM_3_3
	bool "BCM_A_BAND_MOMO_NUM_3x3"
	depends on INCLUDE_WLAN_BCM
	
endchoice


choice 
	prompt "ECONET B_BAND MIMO NUM "
	default RA_B_BAND_MIMO_UNKOWN
	depends on INCLUDE_WLAN_RA
	
config RA_B_BAND_MIMO_NUM_1_1
	bool "RA_B_BAND_MOMO_NUM_1x1"
	depends on INCLUDE_WLAN_RA
	
config RA_B_BAND_MIMO_NUM_2_2
	bool "RA_B_BAND_MOMO_NUM_2x2"
	depends on INCLUDE_WLAN_RA
	
config RA_B_BAND_MIMO_NUM_3_3
	bool "RA_B_BAND_MOMO_NUM_3x3"
	depends on INCLUDE_WLAN_RA
	
endchoice

choice 
	prompt "ECONET A BAND MIMO NUM "
	default RA_A_BAND_MIMO_UNKOWN
	depends on INCLUDE_WLAN_RA && INCLUDE_LAN_WLAN_DUALBAND
	
config RA_A_BAND_MIMO_NUM_1_1
	bool "RA_A_BAND_MOMO_NUM_1x1"
	depends on INCLUDE_WLAN_RA
	
config RA_A_BAND_MIMO_NUM_2_2
	bool "RA_A_BAND_MOMO_NUM_2x2"
	depends on INCLUDE_WLAN_RA
	
config RA_A_BAND_MIMO_NUM_3_3
	bool "RA_A_BAND_MOMO_NUM_3x3"
	depends on INCLUDE_WLAN_RA
	
endchoice

config INCLUDE_BCM_WLAN_FEATURE
	bool "Build Broadcom wlan feature"
	depends on INCLUDE_WLAN_BCM
	default n

config CONFIG_WL0_FOR_5G 
	bool "Build 5G using wl0 interface "
	depends on INCLUDE_WLAN_BCM
	default n
	
endmenu

menu 'DSL Options'

config INCLUDE_ADSLWAN
	bool "Build DSL"
	default n

config INCLUDE_VDSLWAN
	bool "Build vdsl module"
	depends on INCLUDE_ADSLWAN
	default n

config INCLUDE_XTM_DUAL_CFG
	bool "Support Dual ATM/XTM Config exist in one connection"
	depends on INCLUDE_VDSLWAN
	default n
	
config INCLUDE_MACVLAN
	bool "Build MAC VLAN module"
	depends on INCLUDE_VDSLWAN
	default n
	
config INCLUDE_ANNEXB
	bool "Build AnnexB"
	depends on INCLUDE_ADSLWAN
	default n 

config INCLUDE_WAN_VLAN
	bool "Build Vlan tag with WAN"
	depends on INCLUDE_ADSLWAN
	default n

choice
	prompt "ADSL Type"
	default INCLUDE_ADSL_UNKNOW
	depends on INCLUDE_ADSLWAN

config INCLUDE_ADSL_RA
	bool "Build Ralink DSL"

config INCLUDE_ADSL_RTL
	bool "Build Realtek DSL"

config INCLUDE_ADSL_LTQ
	bool "Build Lantiq DSL"

config INCLUDE_ADSL_BCM
	bool "Build Broadcom DSL"
	
endchoice

config INCLUDE_AUTO_PVC
	bool "Build auto PVC"
	default n
choice
	prompt "MTK DSL Driver"
	default INCLUDE_DMT_EN7513G
	depends on INCLUDE_ADSLWAN

config INCLUDE_DMT_EN7513G
	bool "For EN7513G, such as VR500v 422T"

config INCLUDE_DMT_EN7512
	bool "For EN7512, such as PV-W41T-300N"
	
config INCLUDE_DMT_EN7512BA
	bool "For EN7512/BA, such as TD-W9960"
	
endchoice
	
endmenu	# menu 'DSL Options'

menu 'IPv6 Options'
	
config INCLUDE_IPV6
	bool "Build IPv6"
	default n
	
config INCLUDE_IPV6_MLD
	bool "Build IPv6 MLD"
	default n
	depends on INCLUDE_IPV6

config INCLUDE_IPV6_SLAAC
	bool "Build IPv6 WAN SLAAC"
	default n
	depends on INCLUDE_IPV6

config INCLUDE_IPV6_HTTP
	bool "Build IPv6 HTTP & Telnet"
	default n
	depends on INCLUDE_IPV6

config INCLUDE_IPV6_CE_ROUTER_AUTH
	bool "Build for IPv6 CE_Router Auth"
	default n
	depends on INCLUDE_IPV6

endmenu
	
menu 'USB Options'

config INCLUDE_USB
	bool "Build USB"
	default n
	
config INCLUDE_USB_3G_DONGLE
	bool "Build USB 3G dongle"
	default n
	depends on INCLUDE_USB
	
config INCLUDE_USB_OVER_IP
	bool "Build USB over IP"
	default n
	depends on INCLUDE_USB

choice
	prompt "USB over IP Type"
	default INCLUDE_USB_OVER_IP_TPLINK
	depends on INCLUDE_USB_OVER_IP

config INCLUDE_USB_OVER_IP_TPLINK
	bool "Build USB over IP of TP-Link"
	
config INCLUDE_USB_OVER_IP_KCODES
	bool "Build USB over IP of KCodes"
	
config INCLUDE_IPP
	bool "Build IPP Printer Server"
	
endchoice

config INCLUDE_USB_STORAGE
	bool "Build USB storage"
	default n
	depends on INCLUDE_USB
	
config INCLUDE_USB_MEDIA_SERVER
	bool "Build USB DLNA"
	default n
	depends on INCLUDE_USB_STORAGE
	
config INCLUDE_USB_SAMBA_SERVER
	bool "Build USB Samba Server"
	default n
	depends on INCLUDE_USB_STORAGE
	
config INCLUDE_USB_SAMBA4
	bool "Build USB Samba Server 4.6.6"
	default n
	depends on INCLUDE_USB_SAMBA_SERVER
	
config INCLUDE_USB_SAMBA_NMBD
	bool "Build USB Samba NMBD to support netbios name"
	default n
	depends on INCLUDE_USB_SAMBA_SERVER

config INCLUDE_USB_FTP_SERVER
	bool "Build USB Ftp server"
	default n
	depends on INCLUDE_USB_STORAGE

	
endmenu

menu 'VoIP Options'

config INCLUDE_VOIP
	bool "Build VoIP"
	help
	      VOIP Support
	
choice
	prompt "DSP selection"
	depends on INCLUDE_VOIP && (INCLUDE_CPU_TC3182 || INCLUDE_CPU_RT63368)

config INCLUDE_VOIP_WITH_DSP_D2_2S1O
	depends on INCLUDE_VOIP && INCLUDE_CPU_TC3182
	bool "D2 2S1O support"
	def_bool y

config INCLUDE_VOIP_WITH_DSP_MTK
	depends on INCLUDE_VOIP && INCLUDE_CPU_RT63368
	bool "MTK DSP support"
	def_bool y

endchoice

config INCLUDE_DSP_SOCKET_OPEN
	bool "DSP socket open for upper use"
	depends on INCLUDE_VOIP
	default n
	help
		We can call setsockopt for the RTP/RTCP socket
	
config NUM_FXS_CHANNELS
	depends on INCLUDE_VOIP
	int "FxS ports number to be supported"
	range 1 2
	default 2

config INCLUDE_EMERGENCY_CALL
	depends on INCLUDE_VOIP
	bool "support emergency call"
	default n
	help
		support emgergency call

config INCLUDE_P2P_CALL
	depends on INCLUDE_VOIP
	bool "support point to point call"
	default n
	help
		support point to point call

config INCLUDE_DIGITMAP
	depends on INCLUDE_VOIP
	bool "support digitmap"
	default n
	help
		support digitmap

config INCLUDE_USB_VOICEMAIL
	depends on INCLUDE_USB_STORAGE && INCLUDE_VOIP
	bool "INCLUDE USB VOICEMAIL"
	default y
	help
		support usb voicemail function 

config INCLUDE_USBVM_MODULE
	depends on INCLUDE_USB_VOICEMAIL
	bool "INCLUDE USBVM module"
	default y
	help
		Build a usbvm module for usbvm to play voicemail or voice prompt,the HZ MUST be the multiple of 100
   
config INCLUDE_DMZ
	bool "DMZ Support"
	depends on INCLUDE_VOIP
	default y
	help
		SIP uses it to ADD/DEL nat rule	
   
config INCLUDE_CALLLOG
	bool "Call log Support"
	depends on INCLUDE_VOIP	
	default y
   
config INCLUDE_PSTN
	bool "IAD supports PSTN"
	depends on INCLUDE_VOIP
   
config INCLUDE_PSTN_LIFELINE
	bool "IAD supports PSTN lifeline function"
	depends on INCLUDE_PSTN 
   
config INCLUDE_PSTN_POLREV
	bool "PSTN provides polarity reversal to the FXO port"
	depends on INCLUDE_PSTN 
   
config INCLUDE_PSTN_GATEWAY
	bool "IAD can act as VoIP to PSTN or PSTN to VoIP gateway"
	depends on INCLUDE_PSTN 

choice
	prompt "VoIP Locale selection"
	depends on INCLUDE_VOIP
	
config VOIP_LOCALE_ALL
	bool "SUPPORT all countries"
	      
config VOIP_LOCALE_CUSTOM
	bool "Support customized contries"

endchoice

config VOIP_CFG_AUSTRALIA
	bool "Australia"
	depends on VOIP_LOCALE_CUSTOM

config VOIP_CFG_BELGIUM	
	bool "Belgium"
	depends on VOIP_LOCALE_CUSTOM

config VOIP_CFG_BRAZIL
	bool "Brazil"
	depends on VOIP_LOCALE_CUSTOM

config VOIP_CFG_CANADA
	bool "Canada"
	depends on VOIP_LOCALE_CUSTOM

#config VOIP_CFG_CHILE
#	bool "Chile"
#	depends on VOIP_LOCALE_CUSTOM

config VOIP_CFG_CHINA
	bool "China"
	depends on VOIP_LOCALE_CUSTOM

config VOIP_CFG_COLOMBIA
	bool "Colombia"
	depends on VOIP_LOCALE_CUSTOM

#config VOIP_CFG_CZECH
#	bool "Czech"
#	depends on VOIP_LOCALE_CUSTOM

#config VOIP_CFG_DENMARK
#	bool "Denmark"
#	depends on VOIP_LOCALE_CUSTOM

config VOIP_CFG_ETSI
	bool "ETSI"
	depends on VOIP_LOCALE_CUSTOM

#config VOIP_CFG_FINLAND
#	bool "Finland"
#	depends on VOIP_LOCALE_CUSTOM

config VOIP_CFG_FRANCE
	bool "France"
	depends on VOIP_LOCALE_CUSTOM

config VOIP_CFG_GERMANY
	bool "Germany"
	depends on VOIP_LOCALE_CUSTOM

#config VOIP_CFG_HUNGARY
#	bool "Hungary"
#	depends on VOIP_LOCALE_CUSTOM

config VOIP_CFG_INDIA
	bool "India"
	depends on VOIP_LOCALE_CUSTOM

config VOIP_CFG_INDONESIA
	bool "Indonesia"
	depends on VOIP_LOCALE_CUSTOM

config VOIP_CFG_ITALY
	bool "Italy"
	depends on VOIP_LOCALE_CUSTOM

#config VOIP_CFG_JAPAN
#	bool "Japan"
#	depends on VOIP_LOCALE_CUSTOM

config VOIP_CFG_LATVIA
	bool "Latvia"
	depends on VOIP_LOCALE_CUSTOM

config VOIP_CFG_LITHUANIA
	bool "Lithuania"
	depends on VOIP_LOCALE_CUSTOM

config VOIP_CFG_MEXICO
	bool "Mexico"
	depends on VOIP_LOCALE_CUSTOM

#config VOIP_CFG_NETHERLANDS
#	bool "Netherlands"
#	depends on VOIP_LOCALE_CUSTOM

config VOIP_CFG_NEWZEALAND
	bool "New Zealand"
	depends on VOIP_LOCALE_CUSTOM

config VOIP_CFG_NORTH_AMERICA
#	bool "North America"
	def_bool y
	depends on VOIP_LOCALE_CUSTOM

#config VOIP_CFG_NORWAY
#	bool "Norway"
#	depends on VOIP_LOCALE_CUSTOM

config VOIP_CFG_PERU
	bool "Peru"
	depends on VOIP_LOCALE_CUSTOM

config VOIP_CFG_POLAND
	bool "Poland"
	depends on VOIP_LOCALE_CUSTOM

config VOIP_CFG_PORTUGAL
	bool "Portugal"
	depends on VOIP_LOCALE_CUSTOM

config VOIP_CFG_RUSSIA
	bool "Russia"
	depends on VOIP_LOCALE_CUSTOM

config VOIP_CFG_SERBIA
	bool "Serbia"
	depends on VOIP_LOCALE_CUSTOM

config VOIP_CFG_SPAIN
	bool "Spain"
	depends on VOIP_LOCALE_CUSTOM

#config VOIP_CFG_SWEDEN
#	bool "Sweden"
#	depends on VOIP_LOCALE_CUSTOM

#config VOIP_CFG_SWITZERLAND
#	bool "Switzerland"
#	depends on VOIP_LOCALE_CUSTOM

#config VOIP_CFG_TAIWAN
#	bool "Taiwan"
#	depends on VOIP_LOCALE_CUSTOM

config VOIP_CFG_THAILAND
	bool "Thailand"
	depends on VOIP_LOCALE_CUSTOM

config VOIP_CFG_TURKEY
	bool "Turkey"
	depends on VOIP_LOCALE_CUSTOM

config VOIP_CFG_UK
	bool "United Kindom"
	depends on VOIP_LOCALE_CUSTOM

endmenu	# menu 'VoIP Options'


menu 'Function Options'

config INCLUDE_WAN_MODE
	bool "build system mode"
	default y

config INCLUDE_QOS
	bool "build QoS"
	default n
	
config INCLUDE_E8_APP
	bool "build E8 APP"
	default n
	depends on INCLUDE_QOS
	
config INCLUDE_SSL
	bool "build openSSL"
	default n

config INCLUDE_TLS_NEW
	bool "build with tls new version"
	default n
	depends on INCLUDE_SSL

config INCLUDE_IPSEC
	bool "build IPSec"
	default n

config INCLUDE_CWMP
	bool "build CWMP/TR069"
	default n

config INCLUDE_TR111_PART1
	bool "Build TR111 part1"
	default n
	depends on INCLUDE_CWMP
	
config INCLUDE_TR111_PART2
	bool "Build TR111 part2"
	default n
	depends on INCLUDE_CWMP

config INCLUDE_CWMP_SSL
	bool "build SSL CWMP/TR069"
	default n
	depends on INCLUDE_CWMP && INCLUDE_SSL
	
config INCLUDE_CWMP_SSL_VERIFY_PEER
	bool "CWMP verify the certification of peer"
	default n
	depends on INCLUDE_CWMP_SSL
	
config INCLUDE_TR143
	bool "Build TR143"
	default n 
	depends on INCLUDE_CWMP

config INCLUDE_IPPING_DIAG
	bool "Build ipping diag"
	default y 
	depends on INCLUDE_TR143

config INCLUDE_TRACEROUTE_DIAG
	bool "Build traceroute diag"
	default n
	depends on INCLUDE_TR143

config INCLUDE_DOWNLOAD_DIAG
	bool "Build download diag"
	default n
	depends on INCLUDE_TR143

config INCLUDE_UPLOAD_DIAG
	bool "Build upload diag"
	default n
	depends on INCLUDE_TR143

config INCLUDE_UDPECHO_DIAG
	bool "Build udpecho diag"
	default n
	depends on INCLUDE_TR143

config INCLUDE_ECONET_TR143_SPEEDUP
	bool "Build ECN TR143 SPEEDUP"
	default n
	depends on	INCLUDE_TR143

config INCLUDE_TR064
	bool "Build tr064"
	default n
	
config INCLUDE_DSL_DIAG
	bool "Build dsl diag"
	default n
	depends on INCLUDE_CWMP
	
config INCLUDE_IGMP_DIAG
	bool "Build IGMP diag"
	default n
	depends on INCLUDE_CWMP
	depends on INCLUDE_IGMP
	depends on INCLUDE_CUSTOMIZED_SP = "TTNET"

config INCLUDE_RIP
	bool "Build RIP"
	default n

config INCLUDE_SNMP
	bool "Build SNMP"
	default n

config INCLUDE_DDNS
	bool "Build DDNS"
	default n
	
config INCLUDE_DDNS_PH
	bool "Build oray DDNS"
	default n
	depends on INCLUDE_DDNS
	
config INCLUDE_DYNDNS
	bool "Build dyn DDNS"
	default n
	depends on INCLUDE_DDNS
	
config INCLUDE_NOIPDNS
	bool "Build NO-ip DDNS"
	default n
	depends on INCLUDE_DDNS
	
config INCLUDE_DDNS_USERDEFINE
	bool "Build user defined DDNS"
	default n
	depends on INCLUDE_DDNS

config INCLUDE_DDNS_USERDEFINE_DETAIL
	bool "Build user defined DDNS to show detail"
	default n
	depends on INCLUDE_DDNS_USERDEFINE
	
config INCLUDE_IPTV
	bool "Build IPTV"
	default n
	
config INCLUDE_IGMP
	bool "Build IGMP"
	default n

config INCLUDE_IGMP_FASTLEAVE
        bool "Build IGMP FASTLEAVE"
        default n
        depends on INCLUDE_IGMP
        help
                "If you enable this function, when one LAN Client which is one member of a multicast group sends an IGMP LEAVE message to DUT, then DUT will delete it and send no reponse message"


config INCLUDE_DHCP_OPTION_121
	bool "Build DHCP Option 121"
	default n
	help
		"If you enable this function, when dhcpc running on WAN will process the option 121 to add static router entry. This is needed by TTNET IPTV"


config INCLUDE_ETHERNET_WAN
	bool "Build ethernet WAN"
	default n
	
config INCLUDE_DUAL_ACCESS
	bool "Build PPPoE Dual Access"
	default n
	depends on INCLUDE_ETHERNET_WAN
	
config INCLUDE_BRIDGING
	bool "Build bridging"
	default n
	
config INCLUDE_ALG
	bool "Build ALG"
	default n
	
config INCLUDE_ALG_H323
	bool "Build H323 ALG"
	default n
	depends on INCLUDE_ALG

config INCLUDE_ALG_SIP
	bool "Build SIP ALG"
	default n
	depends on INCLUDE_ALG
	
config INCLUDE_ALG_RTSP
	bool "Build RTSP ALG"
	default n
	depends on INCLUDE_ALG
	
config INCLUDE_WAN_DETECT
	bool "Build Wan Detect"
	default n
	
config INCLUDE_ROUTE_BINDING
	bool "Build LAN&WAN binding with Policy Route"
	default n
	
config INCLUDE_PPTP
bool "Build PPTP"
	default n
	
config INCLUDE_L2TP
bool "Build L2TP"
	default n

config INCLUDE_ACL
	bool "Build Basic ACL Function(PING ACL)"
	default n

config INCLUDE_ACL_ADVANCE
	bool "Build Full Access Control List Function(Not support yet!!!)"
	default n
	depends on INCLUDE_ACL

config INCLUDE_DOMAIN_LOGIN
	bool "Build dns module for tplinkmodem.net login"
	default y

config INCLUDE_DNS_PROXY
	bool "Build DNS Proxy"
	default n
	help 
		"Build dnsmasq for dns proxy"

config INCLUDE_ENHANCE_DNS_PROXY
	bool "Build DNS Proxy Enhancement"
	default n
	help 
		"Build dnsmasq enhancement"

config INCLUDE_WEB_WARN
	bool "Build WEB redirection module"
	default n

config INCLUDE_PKTCAP
	bool "Build Packet Capture"
	default n
	help 
		"Build Packet Capture Module to capture packet through the specified WAN"

config INCLUDE_PKTCAP_UPLOAD
        bool "Build packets captured upload function"
        default n
        depends on INCLUDE_PKTCAP

config INCLUDE_PORT_MIRRORING
        bool "Build Port Mirroring"
        default n
        help
                "If enable this function, the WAN Interface will give a copy of the packet received or transmited by itselft to the choosed LAN PORT. This is a function used for debug."

config INCLUDE_LIBPCAP
	bool "Build libpcap"
	default n
	depends on INCLUDE_PKTCAP
	help 
		"If you want to capture the packets, you must enable this"

config INCLUDE_TCPDUMP
	bool "Build tcpdump"
	default n
	depends on INCLUDE_LIBPCAP
	help
		"If you need tcpdump to debug, enable this. Or please disable!"

config INCLUDE_WEB_RESTRICTION
	bool "Build web page restriction"
	default n
	help 
		"just for TTNET now."

config INCLUDE_TT_SYSLOG
	bool "Build TTNET Syslog & Syslog upload"
	default n

config INCLUDE_MULTI_EWAN
	bool "Build Multi ewan with vlan tag"
	default n

config INCLUDE_FR_CODE
	bool "Build Factory reset code"
	default n

config INCLUDE_RB_CODE
	bool "Build reboot code"
	default n

config INCLUDE_TR098_STANDARD
	bool "Build TR98 Standard"
	default n


config INCLUDE_AUTO_GATEWAY
	bool "Build Auto Gateway function"
	default n
config INCLUDE_STRACE
	bool "Build STRACE tool"
	default n
	
config INCLUDE_AUTO_FTP_UPDATE
	bool "Build Automatic firmware update through ftp"
	default n

config INCLUDE_3GBACKUP_PENDING_WITH_VOIP
	bool "3G Backup is pending when iad is busy"
	default y
	depends on INCLUDE_USB_3G_DONGLE && INCLUDE_VOIP

config INCLUDE_EWAN_VLAN
	bool "Build ethernet wan with vlan tag"
	default n
	depends on INCLUDE_ETHERNET_WAN

config INCLUDE_LAN_WAN_BINDING
	bool "Build for LAN WAN binding, different from INCLUDE_ROUTE_BINDING"
	default n

config INCLUDE_HTTPS
	bool "Build Https(SSL)"
	default n

config INCLUDE_FON
	bool "Build Layer2 GRE FON"
	default n

config SUPPORT_MODIFY_LAYER2_PARAMS
	bool "Support modifying layer 2 params, such as PVC, VID, etc"
	default n
	
config INCLUDE_SFTP_SERVER
	bool "Support sftp server"
	default n

config INCLUDE_SSH_ACCESS
	bool "Support ssh"
	default n

config INCLUDE_ENHANCE_PAGE_LOCK
	bool "Support enhance page lock"
	default n
config INCLUDE_INDEPENDENT_ETH_WAN
	bool "support independent eth wan port"
	default n

config INCLUDE_TCSMUX_MTK
	bool "Support econet platform smux vlan function"
	default n
	
config INCLUDE_EWANIPTV_DEFAULT
	bool "Support default ewan_iptv conn"
	default n
	
config INCLUDE_CLASSIFY_AUTH
	bool "support data Node privilege management"
	default n

config INCLUDE_NTP_BIND
	bool "Build NTP wan connection binding"
	default n
	
config INCLUDE_LAN_VLAN
	bool "support lan vlan id configurte"
	default n

config INCLUDE_WORK_AROUND
	bool "support dsl retrain when train to ad mode without getting valid ip"
	default n
	
endmenu  # menu "Function Options"	

menu 'PON Options'

config INCLUDE_PON
        bool "Build PON"
        default n

config INCLUDE_PON_EPON
        bool "Build PON EPON"
        default n
        depends on INCLUDE_PON

config INCLUDE_PON_GPON
        bool "Build PON GPON"
        default n
        depends on INCLUDE_PON

endmenu

menu 'Special Functions Options'

config INCLUDE_GERMANY_SPEC
	bool "Build Germany Spec"
	default n

config INCLUDE_PPP_RECONN
	bool "Build PPP RECONNECTION(usually used in Germany.)"
	default n

config INCLUDE_MER
	bool "Build support for MER dial mode(For UK sky)"
	default n

config INCLUDE_OAM
	bool "Build ethernet OAM test"
	default n

endmenu

menu 'WEB Options'

config WEB_INCLUDE_MULTI_EWAN
	bool "WEB multi Ethernet WAN"
	default n
		
config WEB_INCLUDE_DST
bool "WEB Daylight Savings Time"
	default n

endmenu
```
